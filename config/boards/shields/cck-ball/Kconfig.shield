## config/boards/shields/cck-ball/Kconfig.shield
```kconfig
config SHIELD_CCK-BALL_LEFT
    def_bool $(shields_list_contains,cck-ball_left)

config SHIELD_CCK-BALL_RIGHT
    def_bool $(shields_list_contains,cck-ball_right)
```

## config/boards/shields/charybdis/Kconfig.defconfig
```kconfig
if SHIELD_CCK-BALL_RIGHT

config ZMK_KEYBOARD_NAME
	default "CCK BALL"

config ZMK_SPLIT_BLE_ROLE_CENTRAL
	default y

endif

if SHIELD_CCK-BALL_LEFT || SHIELD_CCK-BALL_RIGHT

config ZMK_SPLIT
	default y

endif
```
